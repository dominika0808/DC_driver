# file: DC_driver.ioc
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Mcu.Family=STM32F3
Mcu.Name=STM32F303C(B-C)Tx
Mcu.Package=LQFP48
NVIC.PriorityGroup=NVIC_PRIORITYGROUP_4
PA13.Mode=Serial_Wire
PA13.Signal=SYS_JTMS-SWDIO
PA14.Mode=Serial_Wire
PA14.Signal=SYS_JTCK-SWCLK
PF0-OSC_IN.Mode=HSE-External-Oscillator
PF0-OSC_IN.Signal=RCC_OSC_IN
PF1-OSC_OUT.Mode=HSE-External-Oscillator
PF1-OSC_OUT.Signal=RCC_OSC_OUT
ProjectManager.HeapSize=0x200
ProjectManager.StackSize=0x400
ProjectManager.TargetToolchain=STM32CubeIDE
RCC.AHBFreq_Value=29491200
RCC.APB1Freq_Value=29491200
RCC.APB1TimFreq_Value=29491200
RCC.APB2Freq_Value=29491200
RCC.APB2TimFreq_Value=29491200
RCC.CortexFreq_Value=29491200
RCC.HCLKFreq_Value=29491200
RCC.HSE_VALUE=7372800
RCC.HSI_VALUE=8000000
RCC.LSE_VALUE=32768
RCC.PLLMUL=RCC_PLL_MUL4
RCC.PLLSourceVirtual=RCC_PLLSOURCE_HSE
RCC.SYSCLKFreq_VALUE=29491200
RCC.SYSCLKSourceVirtual=RCC_SYSCLKSOURCE_PLLCLK
RCC.USBFreq_Value=29491200
board=custom

// file: Core/Src/main.c
/* USER CODE BEGIN Header */
/**
  ******************************************************************************
  * @file           : main.c
  * @brief          : Main program body
  ******************************************************************************
  * @attention
  *
  * Copyright (c) 2025 STMicroelectronics.
  * All rights reserved.
  *
  * This software is licensed under terms that can be found in the LICENSE file
  * in the root directory of this software component.
  * If no LICENSE file comes with this software, it is provided AS-IS.
  *
  ******************************************************************************
  */
/* USER CODE END Header */
#include "main.h"
#include "gpio.h"

/* USER CODE BEGIN Includes */

#include "gpio_config.h"
#include "serial.h"
#include "timer.h"
#include "motor.h"
#include "adc_r.h"

/* USER CODE END Includes */

/* USER CODE BEGIN PTD */

typedef enum{
	SPEED = 0xA1,
	DISTANCE =0xA2,
}msg_t;

/* USER CODE END PTD */

/* USER CODE BEGIN PD */

#define RIGHT_MOTOR_KP					0.3
#define RIGHT_MOTOR_KI					0.05
#define RIGHT_MOTOR_KD					0.01
#define LEFT_MOTOR_KP					0.3
#define LEFT_MOTOR_KI					0.05
#define LEFT_MOTOR_KD					0.01
#define ANTI_WINDUP			        	100

/* USER CODE END PD */

/* USER CODE BEGIN PV */

volatile uint32_t tick;

serwo_str right_motor;
serwo_str left_motor;

uint16_t ADC2_measurement[3];
uint16_t ADC3_measurement[2];
float v_cell_1, v_cell_2, v_cell_3;
uint8_t UART_buffer[5];
int16_t speed_right, speed_left;
uint8_t msg[5] = {0xB1, 0, 97, 0 , 97};

/* USER CODE END PV */

void SystemClock_Config(void);
/* USER CODE BEGIN PFP */

void parse(void);

/* USER CODE END PFP */

int main(void)
{

  /* MCU Configuration--------------------------------------------------------*/

  /* Reset of all peripherals, Initializes the Flash interface and the Systick. */
  HAL_Init();

  /* Configure the system clock */
  SystemClock_Config();

  /* Initialize all configured peripherals */
  MX_GPIO_Init();
  /* USER CODE BEGIN 2 */

  GpioInit();
  Usart3DMAInit();
  Tim1InitPWM();
  Tim2InitPWM();
  Tim3InitEncoderMode();
  Tim4InitEncoderMode();
  Tim7Init();
  Tim15Init();

  motor_str_init(&right_motor, 'R');
  motor_str_init(&left_motor, 'L');
  pid_init(&(right_motor.pid_controller), RIGHT_MOTOR_KP, RIGHT_MOTOR_KI, RIGHT_MOTOR_KD, ANTI_WINDUP);
  pid_init(&(left_motor.pid_controller), LEFT_MOTOR_KP, LEFT_MOTOR_KI, LEFT_MOTOR_KD, ANTI_WINDUP);
  filter_init(&(right_motor.filter));
  filter_init(&(left_motor.filter));

  ADC2Init((uint32_t)&ADC2_measurement);
  ADC3Init((uint32_t)&ADC3_measurement);

  Tim1Start();
  Tim2Start();
  Tim3Start();
  Tim4Start();
  Tim7Start();
  Tim15Start();

  /* USER CODE END 2 */

  /* Infinite loop */
  /* USER CODE BEGIN WHILE */
  while (1)
  {
	  Usart3TransmitDMA((uint32_t)&msg);

	  HAL_Delay(500);

	  v_cell_1 = 3.3f * ADC3_measurement[1] / 4096.0f / 0.72f;
	  v_cell_2 = 3.3f * ADC3_measurement[0] / 4096.0f / 0.35f;
	  v_cell_3 = 3.3f * ADC2_measurement[2] / 4096.0f / 0.25f;
    /* USER CODE END WHILE */

  }
}

void SystemClock_Config(void)
{
  RCC_OscInitTypeDef RCC_OscInitStruct = {0};
  RCC_ClkInitTypeDef RCC_ClkInitStruct = {0};

  /** Initializes the RCC Oscillators according to the specified parameters
  * in the RCC_OscInitTypeDef structure.
  */
  RCC_OscInitStruct.OscillatorType = RCC_OSCILLATORTYPE_HSE;
  RCC_OscInitStruct.HSEState = RCC_HSE_ON;
  RCC_OscInitStruct.HSEPredivValue = RCC_HSE_PREDIV_DIV1;
  RCC_OscInitStruct.HSIState = RCC_HSI_ON;
  RCC_OscInitStruct.PLL.PLLState = RCC_PLL_ON;
  RCC_OscInitStruct.PLL.PLLSource = RCC_PLLSOURCE_HSE;
  RCC_OscInitStruct.PLL.PLLMUL = RCC_PLL_MUL4;
  if (HAL_RCC_OscConfig(&RCC_OscInitStruct) != HAL_OK)
  {
    Error_Handler();
  }

  /** Initializes the CPU, AHB and APB buses clocks
  */
  RCC_ClkInitStruct.ClockType = RCC_CLOCKTYPE_HCLK|RCC_CLOCKTYPE_SYSCLK
                              |RCC_CLOCKTYPE_PCLK1|RCC_CLOCKTYPE_PCLK2;
  RCC_ClkInitStruct.SYSCLKSource = RCC_SYSCLKSOURCE_PLLCLK;
  RCC_ClkInitStruct.AHBCLKDivider = RCC_SYSCLK_DIV1;
  RCC_ClkInitStruct.APB1CLKDivider = RCC_HCLK_DIV1;
  RCC_ClkInitStruct.APB2CLKDivider = RCC_HCLK_DIV1;

  if (HAL_RCC_ClockConfig(&RCC_ClkInitStruct, FLASH_LATENCY_1) != HAL_OK)
  {
    Error_Handler();
  }
}

/* USER CODE BEGIN 4 */

void USART3_IRQHandler(void)
{
	if(USART3->ISR & USART_ISR_IDLE)
	{
		Usart3ReceiverDMA((uint32_t)&UART_buffer);
		parse();

		USART3->ICR |= USART_ICR_IDLECF;
	}
}

void TIM7_IRQHandler(void)
{
	if(TIM7->SR & TIM_SR_UIF)
	{
		motor_calculate_speed(&right_motor);
		motor_calculate_speed(&left_motor);
		motor_run_pid(&left_motor);
		motor_run_pid(&right_motor);

		TIM7->SR &= ~(TIM_SR_UIF);
	}

}

/*
void HAL_ADC_ConvCpltCallback(ADC_HandleTypeDef* hadc)
{
	if (hadc -> Instance == ADC2)
	{
		filter_add_data(&(right_motor.filter), ADC2_measurement[1]);
		filter_add_data(&(left_motor.filter), ADC2_measurement[0]);

		v_cell_1 = 3.3f * ADC2_measurement[2] / 4096.0f;
		v_cell_2 = 3.3f * ADC3_measurement[0] / 4096.0f;
		v_cell_3 = 3.3f * ADC3_measurement[1] / 4096.0f;
	}
}
*/
void parse(void)
{
	switch(UART_buffer[0])
	{
		case SPEED:
			speed_right = (int16_t)(UART_buffer[1]<<8 | UART_buffer[2]);
			speed_left = (int16_t)(UART_buffer[3]<<8 | UART_buffer[4]);
			motor_set_speed(&right_motor, speed_right);
			motor_set_speed(&left_motor, speed_left);
			break;
		case DISTANCE:
			break;
		default:
			break;
	}
}

/* USER CODE END 4 */

void Error_Handler(void)
{
  __disable_irq();
  while (1)
  {
  }
}
